## firmware/main/Kconfig.projbuild
```kconfig
menu "Watch WiFi / SNTP (roadmap 1.3)"

    config WATCH_WIFI_STA_ENABLE
        bool "Enable WiFi STA + SNTP, write PCF85063"
        default y
        help
            When SSID is non-empty: init netif, connect STA, run SNTP, on success write Asia/Shanghai wall time to RTC.
            Password may be empty for open AP.

    config WATCH_WIFI_STA_SSID
        string "Wi-Fi SSID"
        depends on WATCH_WIFI_STA_ENABLE
        default ""
        help
            Leave empty to skip WiFi/SNTP at boot (no connect).

    config WATCH_WIFI_STA_PASSWORD
        string "Wi-Fi password"
        depends on WATCH_WIFI_STA_ENABLE
        default ""

endmenu

menu "Watch display power (roadmap 1.5)"

    config WATCH_DISPLAY_IDLE_TIMEOUT_SEC
        int "Blank display after idle seconds (0 = off)"
        range 0 3600
        default 30
        help
            Uses LVGL pointer inactivity (last PRESS). After this many idle seconds,
            panel DISPOFF via bsp_lcd; next touch wakes (DISPON + full scr invalidate).

endmenu
```

## firmware/sdkconfig.defaults
```kconfig
# ESP32-S3 + Octal PSRAM (watch-diy scaffold; Waveshare 1.43 N16R8 class boards)
# Target is set by: idf.py set-target esp32s3 (do not set CONFIG_IDF_TARGET here)
# Flash: 16MB (N16); aligns binary header with chip to avoid spi_flash size warning

CONFIG_ESPTOOLPY_FLASHSIZE_16MB=y

CONFIG_ESP_DEFAULT_CPU_FREQ_MHZ_240=y

CONFIG_SPIRAM=y
CONFIG_SPIRAM_BOOT_INIT=y
CONFIG_SPIRAM_MODE_OCT=y
CONFIG_SPIRAM_SPEED_80M=y

CONFIG_FREERTOS_HZ=1000

# LVGL: Montserrat 14 UI + 48 clock (English UI; avoids SimSun CJK subset issues)
CONFIG_LV_FONT_MONTSERRAT_14=y
CONFIG_LV_FONT_DEFAULT_MONTSERRAT_14=y
CONFIG_LV_FONT_MONTSERRAT_48=y
# CONFIG_LV_FONT_SIMSUN_16_CJK is not set
# CONFIG_LV_FONT_DEFAULT_SIMSUN_16_CJK is not set

# Faster indev polling so short taps are not missed between samples (default 30ms is too slow)
CONFIG_LV_INDEV_DEF_READ_PERIOD=10

# Custom partition table: factory + ota_0/ota_1 + otadata placeholder (see partitions_watch.csv)
CONFIG_PARTITION_TABLE_CUSTOM=y
CONFIG_PARTITION_TABLE_CUSTOM_FILENAME="partitions_watch.csv"
# CONFIG_PARTITION_TABLE_SINGLE_APP is not set

# Watch roadmap 1.3: WiFi + SNTP (SSID/password via menuconfig; empty SSID = skip at boot)
CONFIG_WATCH_WIFI_STA_ENABLE=y
CONFIG_WATCH_WIFI_STA_SSID=""
CONFIG_WATCH_WIFI_STA_PASSWORD=""

# Roadmap 1.5: idle blank; 0 disables
CONFIG_WATCH_DISPLAY_IDLE_TIMEOUT_SEC=30
```
